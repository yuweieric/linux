## drivers/gpu/arm/Kconfig
```kconfig
config MALI_PLATFORM_HIKEY
        tristate "Hikey Mali configs"
        default n

config MALI_PLATFORM_HIKEY960
        tristate "Hikey960 Mali configs"
        default n

config MALI_PLATFORM_HIKEY970
        tristate "Hikey970 Mali configs"
        default n

menu "ARM GPU Configuration"

if MALI_PLATFORM_HIKEY
source "drivers/gpu/arm/utgard/Kconfig"
endif

if MALI_PLATFORM_HIKEY960
source "drivers/gpu/arm/bifrost-hikey960/Kconfig"
endif

if MALI_PLATFORM_HIKEY970
source "drivers/gpu/arm/bifrost-hikey970/Kconfig"
endif

endmenu
```

## drivers/gpu/drm/hisilicon/Kconfig
```kconfig
#
# hisilicon drm device configuration.
# Please keep this list sorted alphabetically

source "drivers/gpu/drm/hisilicon/kirin/Kconfig"

source "drivers/gpu/drm/hisilicon/kirin9xx/Kconfig"
```

## drivers/hisi/hifi_dsp/Kconfig
```kconfig
menu "Hifimisc driver serve HIFI dsp"

config HIFI_DSP_ONE_TRACK
     bool "hifi low power play device support"
     help
          hifi lpp device provide service for HIFI and AP, in case of HIFI ultra-low power audio play.

config HIKEY970_HIFI
     bool "special memory mmap for hikey970"
     help
          special memory mmap for hikey970.
endmenu
```

## drivers/hisi/ics/Kconfig
```kconfig
#
# Cambricon IPU Platform Specific Drivers
#

menuconfig HISI_ICS_IPU_PLATFORM
	bool "Platform supoort for Cambricon IPU Device"
	default y
	help
	  Say Y here to get to see options for device drivers of various
	  Cambricon IPU platforms. This option itself does not add any kernel code.

	  If you say N, all options in this submenu will be skipped and disabled.

if HISI_ICS_IPU_PLATFORM

config HISI_ICS_IPU
	tristate "Cambricon IPU Driver"
	default y
	help
	  Cambricon IPU Platform driver.

config HISI_IPU_SET_VCODECBUS
	tristate "Allow IPU Driver to set VCODEC bus clock rate"
	default n
	help
	  Allow IPU Driver to set VCODEC bus clock rate.

config HISI_IPU_REGULATOR
	tristate "Enable IPU Driver regulator control"
	default n
	help
	  Enable IPU Driver regulator control.

endif # HISI_ICS_IPU_PLATFORM
```

## drivers/misc/farichild/Kconfig
```kconfig
#
# farichild devices
#

menu "farichild devices"
source "drivers/misc/farichild/switch/Kconfig"
source "drivers/misc/farichild/otg_gpio_switch/Kconfig"
endmenu
```

## drivers/video/fbdev/hisi/Kconfig
```kconfig
config HISI_FB_KIRIN960
	tristate "HISI FB KIRIN960 Framebuffer support"
	depends on FB_HISI

	help
	  This framebuffer driver supports KIRIN960 FB.
```
